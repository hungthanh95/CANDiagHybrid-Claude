/* flexdiag_tcp.can -- Option A transport: CAPL TCP server.
 * Implements docs/03-TECHNICAL-DETAIL.md §3.2 (line protocol over TCP).
 * NOT protected: transport-only. Calls into flexdiag_core.can's Do* helpers
 * and implements the PublishRsp(seq,status,data,len,kind) hook (docs/04 §2.1).
 *
 * Verify against your CANalyzer 16/17 Help: TcpOpen/TcpBind/TcpListen/
 * TcpAccept/TcpSend/TcpReceive/TcpClose signatures and the accept/receive
 * event names (on TcpConnect / on TcpAccept / on TcpRequestReceive, etc.)
 * can vary by tool version and CAPL TCP/IP API revision.
 */

variables
{
  dword gListenSocket;
  dword gClientSocket;
  int   gHasClient;

  const int kPort = 9000;
  const dword kMaxLine = 4095;

  byte gRxBuf[4095];
  dword gRxLen;
}

on preStart
{
  TcpOpen(gListenSocket);
  TcpBind(gListenSocket, "127.0.0.1", kPort);
  TcpListen(gListenSocket);
  gHasClient = 0;
  gRxLen = 0;
  write("FlexDiag TCP listening on %d", kPort);
}

/* New inbound connection. Single-client v1: reject extra connections with
 * "0 ERR 503 busy" and close them (docs/04 §1: don't crash, stay alive). */
on TcpConnect gListenSocket
{
  dword newSocket;
  newSocket = TcpAccept(gListenSocket);

  if (gHasClient)
  {
    TcpSendText(newSocket, "0 ERR 503 busy\n");
    TcpClose(newSocket);
    return;
  }

  gClientSocket = newSocket;
  gHasClient = 1;
  gRxLen = 0;
  TcpSendText(gClientSocket, "0 READY proto=1 tool=CANalyzer transport=A maxlen=4095\n");
}

on TcpClose gClientSocket
{
  gHasClient = 0;
  gRxLen = 0;
}

/* Line-buffer incoming bytes on '\n'; dispatch each complete line. */
on TcpReceive gClientSocket
{
  byte chunk[4095];
  dword n, i;

  n = TcpReceive(gClientSocket, chunk, elcount(chunk));

  for (i = 0; i < n; i++)
  {
    if (chunk[i] == 0x0A)            // '\n'
    {
      HandleLine(gRxBuf, gRxLen);
      gRxLen = 0;
      continue;
    }
    if (chunk[i] == 0x0D) continue;  // ignore '\r'

    if (gRxLen >= kMaxLine)
    {
      // Line too long: per docs/03 §1.5, reject and close.
      TcpSendText(gClientSocket, "0 ERR 422 bad_args\n");
      TcpClose(gClientSocket);
      gHasClient = 0;
      gRxLen = 0;
      return;
    }
    gRxBuf[gRxLen] = chunk[i];
    gRxLen++;
  }
}

/* ---- Line parsing helpers ---- */

int IsDigit(byte c) { return (c >= '0' && c <= '9'); }

int IsHexDigit(byte c)
{
  return ((c >= '0' && c <= '9') || (c >= 'A' && c <= 'F') || (c >= 'a' && c <= 'f'));
}

int HexNibble(byte c)
{
  if (c >= '0' && c <= '9') return c - '0';
  if (c >= 'A' && c <= 'F') return c - 'A' + 10;
  return c - 'a' + 10;
}

/* Uppercase ASCII in place (verbs are matched case-sensitively below). */
void UpperInPlace(byte buf[], dword len)
{
  dword i;
  for (i = 0; i < len; i++)
  {
    if (buf[i] >= 'a' && buf[i] <= 'z') buf[i] = buf[i] - 'a' + 'A';
  }
}

/* Parse a decimal SEQ from buf[0..len-1] starting at *pos; advances *pos
 * past the token and the following space. Returns -1 on malformed seq. */
long ParseSeq(byte buf[], dword len, dword* pos)
{
  long val;
  dword start;

  val = 0;
  start = *pos;
  while (*pos < len && IsDigit(buf[*pos]))
  {
    val = val * 10 + (buf[*pos] - '0');
    (*pos)++;
  }
  if (*pos == start) return -1;       // no digits at all
  if (*pos < len && buf[*pos] == ' ') (*pos)++;
  return val;
}

/* Extract the next space-delimited token into out[]; returns its length.
 * Advances *pos past the token and one trailing space (if any). */
dword NextToken(byte buf[], dword len, dword* pos, byte out[], dword outMax)
{
  dword start, n;

  while (*pos < len && buf[*pos] == ' ') (*pos)++;
  start = *pos;
  while (*pos < len && buf[*pos] != ' ') (*pos)++;

  n = *pos - start;
  if (n > outMax) n = outMax;
  memcpy(out, &buf[start], n);

  if (*pos < len && buf[*pos] == ' ') (*pos)++;
  return n;
}

/* Decode the remaining space-separated hex bytes (e.g. "22 F1 90") into
 * out[]. Returns the byte count, or -1 on malformed hex. */
long ParseHexBytes(byte buf[], dword len, dword pos, byte out[], dword outMax)
{
  dword n;
  byte hi, lo;

  n = 0;
  while (pos < len)
  {
    while (pos < len && buf[pos] == ' ') pos++;
    if (pos >= len) break;

    if (pos + 1 >= len || !IsHexDigit(buf[pos]) || !IsHexDigit(buf[pos + 1]))
      return -1;

    hi = buf[pos];
    lo = buf[pos + 1];
    pos += 2;

    if (pos < len && buf[pos] != ' ') return -1;   // not exactly 2 hex digits

    if (n >= outMax) return -1;                    // exceeds kMaxLen payload
    out[n] = (byte)((HexNibble(hi) << 4) | HexNibble(lo));
    n++;
  }
  return (long)n;
}

dword strcmp_eq(byte a[], dword aLen, char b[])
{
  dword bLen, i;
  bLen = strlen(b);
  if (aLen != bLen) return 0;
  for (i = 0; i < aLen; i++)
  {
    if (a[i] != b[i]) return 0;
  }
  return 1;
}

/* ---- Per-line dispatch ---- */
void HandleLine(byte line[], dword len)
{
  dword pos;
  long  seq;
  byte  verb[16];
  dword verbLen;
  byte  arg1[16];
  dword arg1Len;
  byte  payload[4095];
  long  payloadLen;

  if (len == 0) return;

  pos = 0;
  seq = ParseSeq(line, len, &pos);
  if (seq < 0)
  {
    TcpSendText(gClientSocket, "0 ERR 422 bad_args\n");
    return;
  }

  verbLen = NextToken(line, len, &pos, verb, elcount(verb));
  UpperInPlace(verb, verbLen);

  write("RX seq=%d verb=%s", seq, verb);

  if (strcmp_eq(verb, verbLen, "HELLO"))
  {
    TcpSendF(seq, "READY proto=1 tool=CANalyzer transport=A maxlen=4095");
    return;
  }

  if (strcmp_eq(verb, verbLen, "PING"))
  {
    TcpSendF(seq, "PONG");
    return;
  }

  if (strcmp_eq(verb, verbLen, "BYE"))
  {
    TcpClose(gClientSocket);
    gHasClient = 0;
    return;
  }

  if (strcmp_eq(verb, verbLen, "SESSION"))
  {
    arg1Len = NextToken(line, len, &pos, arg1, elcount(arg1));
    if (arg1Len != 2 || !IsHexDigit(arg1[0]) || !IsHexDigit(arg1[1]))
    {
      TcpSendF(seq, "ERR 422 bad_args");
      return;
    }
    DoSessionControl((dword)seq, (byte)((HexNibble(arg1[0]) << 4) | HexNibble(arg1[1])));
    return;
  }

  if (strcmp_eq(verb, verbLen, "READDTC"))
  {
    byte mask;
    arg1Len = NextToken(line, len, &pos, arg1, elcount(arg1));
    if (arg1Len == 0)
    {
      mask = 0xFF;                    // default mask per docs/03 §1.2
    }
    else if (arg1Len == 2 && IsHexDigit(arg1[0]) && IsHexDigit(arg1[1]))
    {
      mask = (byte)((HexNibble(arg1[0]) << 4) | HexNibble(arg1[1]));
    }
    else
    {
      TcpSendF(seq, "ERR 422 bad_args");
      return;
    }
    DoReadDtcByStatusMask((dword)seq, mask);
    return;
  }

  if (strcmp_eq(verb, verbLen, "CLEARDTC"))
  {
    DoClearDtc((dword)seq);
    return;
  }

  if (strcmp_eq(verb, verbLen, "SECURITY"))
  {
    arg1Len = NextToken(line, len, &pos, arg1, elcount(arg1));
    if (arg1Len != 2 || !IsHexDigit(arg1[0]) || !IsHexDigit(arg1[1]))
    {
      TcpSendF(seq, "ERR 422 bad_args");
      return;
    }
    DoSecurityRequestSeed((dword)seq, (byte)((HexNibble(arg1[0]) << 4) | HexNibble(arg1[1])));
    return;
  }

  if (strcmp_eq(verb, verbLen, "TP"))
  {
    byte noData[1];
    arg1Len = NextToken(line, len, &pos, arg1, elcount(arg1));
    UpperInPlace(arg1, arg1Len);
    if (strcmp_eq(arg1, arg1Len, "START"))
    {
      DoTpStart();
      PublishRsp((dword)seq, 2, noData, 0, 5);   // -> "OK TP"
      return;
    }
    if (strcmp_eq(arg1, arg1Len, "STOP"))
    {
      DoTpStop();
      PublishRsp((dword)seq, 2, noData, 0, 6);   // -> "OK TP"
      return;
    }
    TcpSendF(seq, "ERR 422 bad_args");
    return;
  }

  if (strcmp_eq(verb, verbLen, "RAW"))
  {
    payloadLen = ParseHexBytes(line, len, pos, payload, elcount(payload));
    if (payloadLen <= 0)
    {
      TcpSendF(seq, "ERR 422 bad_args");
      return;
    }
    DoRaw((dword)seq, payload, (dword)payloadLen);
    return;
  }

  TcpSendF(seq, "ERR 400 unknown_verb");
}

/* ---- Outbound line helpers ---- */

/* Send "<seq> <fmt...>\n". %s/%d not needed beyond literal strings here;
 * kept as a thin wrapper so every outbound line goes through one place. */
void TcpSendF(long seq, char text[])
{
  char line[2048];
  snprintf(line, elcount(line), "%d %s\n", seq, text);
  TcpSendText(gClientSocket, line);
}

void TcpSendHexLine(long seq, char verb[], byte data[], dword len)
{
  char line[2048];
  char hexPart[2048];
  dword i, p;
  char nibble[16] = "0123456789ABCDEF";

  p = 0;
  for (i = 0; i < len; i++)
  {
    if (p + 3 >= elcount(hexPart)) break;   // bound write (docs/04 §2.5)
    hexPart[p++] = nibble[(data[i] >> 4) & 0x0F];
    hexPart[p++] = nibble[data[i] & 0x0F];
    if (i + 1 < len) hexPart[p++] = ' ';
  }
  hexPart[p] = 0;

  if (len == 0)
    snprintf(line, elcount(line), "%d %s\n", seq, verb);
  else
    snprintf(line, elcount(line), "%d %s %s\n", seq, verb, hexPart);

  write("TX seq=%d %s", seq, line);
  TcpSendText(gClientSocket, line);
}

/* ---- Core transport hook (docs/03 §3.1/§3.2) ---- */
void PublishRsp(dword seq, int status, byte data[], dword len, int kind)
{
  char line[64];
  char nibble[16] = "0123456789ABCDEF";
  byte oddLevel;

  if (!gHasClient) return;

  switch (status)
  {
    case 0:                                   // positive UDS response
      TcpSendHexLine((long)seq, "RSP", data, len);
      break;

    case 1:                                   // negative response (7F sid nrc),
                                               // including 7F sid 78 (pending) --
                                               // the final response follows as a
                                               // second line, same seq.
      if (len >= 3)
      {
        snprintf(line, elcount(line), "%d NRC %c%c %c%c\n", seq,
                 nibble[(data[1] >> 4) & 0x0F], nibble[data[1] & 0x0F],
                 nibble[(data[2] >> 4) & 0x0F], nibble[data[2] & 0x0F]);
      }
      else
      {
        snprintf(line, elcount(line), "%d NRC 00 00\n", seq);  // defensive
      }
      TcpSendText(gClientSocket, line);
      break;

    case 2:                                   // non-UDS OK
      if (kind == 3)
      {
        // data = "67 <evenLevel>"; the odd level originally requested via
        // SECURITY <level> is evenLevel - 1 (docs/03 §3.1 nuance).
        oddLevel = (len >= 2) ? (byte)(data[1] - 1) : 0;
        snprintf(line, elcount(line), "%d OK SEC %c%c\n", seq,
                 nibble[(oddLevel >> 4) & 0x0F], nibble[oddLevel & 0x0F]);
        TcpSendText(gClientSocket, line);
      }
      else if (kind == 5 || kind == 6)
        TcpSendF((long)seq, "OK TP");
      // SESSION (kind==4) never reaches status==2: a positive 0x10 response
      // is status==0 and is handled by case 0 above (docs/03 §1.3: "SESSION
      // responses use RSP like READDTC/RAW, never OK").
      break;

    case 3:                                   // error (e.g. keygen_fail)
      TcpSendF((long)seq, "ERR 500 keygen_fail");
      break;
  }
}
